## conf/layer.conf
```bitbake
# We have a conf and classes directory, add to BBPATH
BBPATH .= ":${LAYERDIR}"

# We have a recipes-* directories, add to BBFILES
BBFILES += "${LAYERDIR}/recipes-*/*/*.bb \
            ${LAYERDIR}/recipes-*/*/*.bbappend"

BBFILE_COLLECTIONS += "tft-leakage"
BBFILE_PATTERN_tft-leakage = "^${LAYERDIR}/"
BBFILE_PRIORITY_tft-leakage = "10"

LAYERVERSION_tft-leakage = "1"
LAYERSERIES_COMPAT_tft-leakage = "kirkstone langdale mickledore"

# Set additional variables
BBFILE_SKIP_tft-leakage += "${LAYERDIR}/recipes-apps/tft-leakage-daemon/files/"
```
